## build/Kconfig/arch/Kconfig
```kconfig
# Load Zephyr Arch Kconfig descriptions.
osource "/home/arch_matias/zephyrproject/zephyr/arch/rx/Kconfig"
osource "/home/arch_matias/zephyrproject/zephyr/arch/x86/Kconfig"
osource "/home/arch_matias/zephyrproject/zephyr/arch/xtensa/Kconfig"
osource "/home/arch_matias/zephyrproject/zephyr/arch/sparc/Kconfig"
osource "/home/arch_matias/zephyrproject/zephyr/arch/riscv/Kconfig"
osource "/home/arch_matias/zephyrproject/zephyr/arch/posix/Kconfig"
osource "/home/arch_matias/zephyrproject/zephyr/arch/openrisc/Kconfig"
osource "/home/arch_matias/zephyrproject/zephyr/arch/mips/Kconfig"
osource "/home/arch_matias/zephyrproject/zephyr/arch/arm64/Kconfig"
osource "/home/arch_matias/zephyrproject/zephyr/arch/arm/Kconfig"
osource "/home/arch_matias/zephyrproject/zephyr/arch/arc/Kconfig"
```

## build/Kconfig/boards/Kconfig
```kconfig
# Load Zephyr board Kconfig descriptions.
osource "/home/arch_matias/zephyrproject/zephyr/boards/seeed/xiao_ble/Kconfig"
```

## build/Kconfig/boards/Kconfig.defconfig
```kconfig
# Load Zephyr board defconfig descriptions.
osource "/home/arch_matias/zephyrproject/zephyr/boards/seeed/xiao_ble/Kconfig.defconfig"
```

## build/Kconfig/boards/Kconfig.sysbuild
```kconfig
# Load Sysbuild board Kconfig descriptions.
osource "/home/arch_matias/zephyrproject/zephyr/boards/seeed/xiao_ble/Kconfig.sysbuild"
```

## build/Kconfig/boards/Kconfig.xiao_ble
```kconfig
# Load board Kconfig descriptions.
osource "/home/arch_matias/zephyrproject/zephyr/boards/seeed/xiao_ble/Kconfig.xiao_ble"
```
